#include "custom_split.dtsi"

&default_transform {
    col-offset = <6>; // Tells ZMK this is the right half
};

&kscan0 {
    // You must replace these placeholders with your actual KiCad pins!
    col-gpios
        = <&xiao_d 0 GPIO_ACTIVE_HIGH> // Column 1 (Inner)
        , <&xiao_d 1 GPIO_ACTIVE_HIGH> // Column 2
        , <&xiao_d 2 GPIO_ACTIVE_HIGH> // Column 3
        , <&xiao_d 3 GPIO_ACTIVE_HIGH> // Column 4
        , <&xiao_d 4 GPIO_ACTIVE_HIGH> // Column 5
        , <&xiao_d 5 GPIO_ACTIVE_HIGH> // Column 6 (Far Right)
        ;

    row-gpios
        = <&xiao_d 6 (GPIO_ACTIVE_HIGH | GPIO_PULL_DOWN)> // Row 1 (Top)
        , <&xiao_d 7 (GPIO_ACTIVE_HIGH | GPIO_PULL_DOWN)> // Row 2
        , <&xiao_d 8 (GPIO_ACTIVE_HIGH | GPIO_PULL_DOWN)> // Row 3
        , <&xiao_d 9 (GPIO_ACTIVE_HIGH | GPIO_PULL_DOWN)> // Row 4
        ;
};